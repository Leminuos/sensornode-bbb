## meta-sensornode-bsp/conf/layer.conf
```bitbake
# Layer:  meta-sensornode-bsp
# Scope:  hardware only — machine configuration, kernel, bootloader.

BBPATH .= ":${LAYERDIR}"

BBFILES += "${LAYERDIR}/recipes-*/*/*.bb \
            ${LAYERDIR}/recipes-*/*/*.bbappend"

BBFILE_COLLECTIONS += "sensornode-bsp"
BBFILE_PATTERN_sensornode-bsp = "^${LAYERDIR}/"
BBFILE_PRIORITY_sensornode-bsp = "6"

LAYERVERSION_sensornode-bsp        = "1"
LAYERDEPENDS_sensornode-bsp        = "core yoctobsp"
LAYERSERIES_COMPAT_sensornode-bsp  = "kirkstone"
```

## meta-sensornode-bsp/conf/machine/include/bbb-common.inc
```bitbake
require conf/machine/beaglebone-yocto.conf

MACHINEOVERRIDES =. "beaglebone-yocto:"

KERNEL_DEVICETREE       = "am335x-boneblack.dtb"

UBOOT_DTB_BINARY        = "u-boot.dtb"
UBOOT_NODTB_BINARY      = "u-boot-nodtb.bin"

UBOOT_ENTRYPOINT        = "0x80008000"
UBOOT_LOADADDRESS       = "0x80008000"
UBOOT_DTB_LOADADDRESS   = "0x88000000"

UBOOT_SIGN_ENABLE       = "${@bb.utils.contains('DISTRO_FEATURES', 'sensornode-secureboot', '1', '0', d)}"
UBOOT_SIGN_KEYDIR       ?= "${SENSORNODE_KEYDIR}"
UBOOT_SIGN_KEYNAME      ?= "${SENSORNODE_KEYNAME}"

FIT_GENERATE_KEYS       = "0"
FIT_SIGN_ALG            = "rsa2048"
FIT_HASH_ALG            = "sha256"

KERNEL_IMAGETYPE        = "${@bb.utils.contains('DISTRO_FEATURES', 'sensornode-secureboot', 'fitImage', 'zImage', d)}"
KERNEL_CLASSES:append   = "${@bb.utils.contains('DISTRO_FEATURES', 'sensornode-secureboot', ' kernel-fitimage', '', d)}"
```

## meta-sensornode/conf/distro/include/sensornode-base.inc
```bitbake
require conf/distro/poky.conf

DISTRO_NAME = "SensorNode"
DISTRO_VERSION = "1.0"

DISTRO_FEATURES:remove = " \
    x11 \
    wayland \
    opengl \
    vulkan \
    bluetooth \
    nfc \
    3g \
    ppp \
    pcmcia \
    wifi \
    alsa \
    pulseaudio \
    gobject-introspection-data \
    pci \
    zeroconf \
    debuginfod \
    multiarch \
"

DISTRO_FEATURES:append = " systemd"

PACKAGECONFIG_DISTRO:pn-qtbase = " \
    linuxfb \
    tslib \
    fontconfig \
"

TOOLCHAIN_TARGET_TASK:append = " \
    libgpiod-dev \
    mosquitto-dev \
    nlohmann-json-dev \
    libsqlite3-dev \
    libubootenv-dev \
    swupdate-dev \
"

VIRTUAL-RUNTIME_init_manager = "systemd"
DISTRO_FEATURES_BACKFILL_CONSIDERED += "sysvinit"
VIRTUAL_RUNTIME_initscripts = "systemd-compat-units"

# The kernel and DTB live in the signed FIT at the end of each slot
MACHINE_ESSENTIAL_EXTRA_RDEPENDS:remove = "${@bb.utils.contains('DISTRO_FEATURES', 'sensornode-verity', 'kernel-image kernel-devicetree', '', d)}"
MACHINE_EXTRA_RRECOMMENDS:remove = "${@bb.utils.contains('DISTRO_FEATURES', 'sensornode-verity', 'kernel-devicetree', '', d)}"

TMPDIR = "${TOPDIR}/tmp-${DISTRO}"

require conf/include/sensornode-vars.inc
```

## meta-sensornode/conf/distro/sensornode-dev.conf
```bitbake
#
# SensorNode development distro
#

require conf/distro/include/sensornode-base.inc

DISTRO = "sensornode-dev"

SENSORNODE_KEYDIR = "${SENSORNODE_DEV_KEYDIR}"

DISTRO_FEATURES:append = " \
    sensornode-ota \
    sensornode-hmi \
    sensornode-devtools \
    sensornode-login \
    sensornode-debug \
"
```

## meta-sensornode/conf/distro/sensornode.conf
```bitbake
#
# SensorNode production distro
#

require conf/distro/include/sensornode-base.inc

DISTRO = "sensornode"

SENSORNODE_KEYDIR = "${SENSORNODE_PRODUCT_KEYDIR}"

DISTRO_FEATURES:append = " \
    sensornode-ota \
    sensornode-hmi \
    sensornode-secureboot \
    sensornode-readonly \
"
```

## meta-sensornode/conf/layer.conf
```bitbake
# Layer:  meta-sensornode
# Scope:  product — distro, images, application, OTA.

BBPATH .= ":${LAYERDIR}"

BBFILES += "${LAYERDIR}/recipes-*/*/*.bb \
            ${LAYERDIR}/recipes-*/*/*.bbappend"

BBFILE_COLLECTIONS += "sensornode"
BBFILE_PATTERN_sensornode = "^${LAYERDIR}/"
BBFILE_PRIORITY_sensornode = "10"

LAYERVERSION_sensornode        = "1"
LAYERDEPENDS_sensornode        = "core yocto openembedded-layer networking-layer qt5-layer swupdate sensornode-bsp"
LAYERSERIES_COMPAT_sensornode  = "kirkstone"
```
